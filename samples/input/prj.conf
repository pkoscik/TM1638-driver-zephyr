## CMakeLists.txt
```
cmake_minimum_required(VERSION 3.13.1)
find_package(Zephyr REQUIRED HINTS $ENV{ZEPHYR_BASE})

project(app LANGUAGES C)

target_include_directories(app PUBLIC include)
target_sources(app PRIVATE src/main.c)
```

## prj.conf
```kconfig
CONFIG_GPIO=y
CONFIG_TM1638=y
```

## boards/nucleo_f767zi.overlay
```dts
/ {
	tm1638_0: tm1638 {
        compatible = "titanmicro,tm1638";
        stb-gpios = <&gpiof 0 GPIO_ACTIVE_HIGH>;
        clk-gpios = <&gpiof 1 GPIO_ACTIVE_HIGH>;
        dio-gpios = <&gpiof 2 (GPIO_ACTIVE_HIGH | GPIO_ACTIVE_HIGH)>; 
    };
};

&gpiof {
	status = "okay";
};
```

## src/main.c
```c
#include <drivers/tm1638.h>
#include <stdio.h>
#include <zephyr/device.h>
#include <zephyr/kernel.h>

int main(void) {
  const struct device* tm_dev = DEVICE_DT_GET_ANY(titanmicro_tm1638);

  if (!device_is_ready(tm_dev)) {
    printf("TM1638 device is not ready!\n");
    return 0;
  }

  tm1638_config_display(tm_dev, 0x0, true);

  char text[SEGMENT_COUNT] = "        ";
  uint8_t leds[SEGMENT_COUNT] = {0};

  while (1) {
    uint8_t keys = tm1638_read_keys(tm_dev);

    for (int i = 0; i < SEGMENT_COUNT; i++) {
      if (keys & (1 << i)) {
        leds[i] = 1;
        text[i] = '1';
      } else {
        leds[i] = 0;
        text[i] = '0';
      }
    }

    tm1638_set_state(tm_dev, text, leds);
    k_msleep(50);
  }

  return 0;
}
```
