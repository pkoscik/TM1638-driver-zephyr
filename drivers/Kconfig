## drivers/tm1638/Kconfig
```kconfig
config TM1638
	bool "TM1638 LED controller and key scanner driver"
	default y
	depends on DT_HAS_TITANMICRO_TM1638_ENABLED
	help
	  Enable driver for the TM1638 controller.
```

## dts/bindings/titanmicro,tm1638.yaml
```yaml
description: Titan Microelectronics TM1638 LED controller

compatible: "titanmicro,tm1638"

include: base.yaml

properties:
  stb-gpios:
    type: phandle-array
    required: true
    description: Strobe pin (STB)

  clk-gpios:
    type: phandle-array
    required: true
    description: Clock pin (CLK)

  dio-gpios:
    type: phandle-array
    required: true
    description: Data I/O pin (DIO)
```
